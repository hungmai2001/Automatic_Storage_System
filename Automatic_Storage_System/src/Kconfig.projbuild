## Automatic_Storage_System/src/Kconfig.projbuild
```kconfig
menu "Example configuration"

config XCLK_FREQ
  int "XCLK Frequency"
  default "20000000"
  help
      The XCLK Frequency in Herz.
      
menu "Pin Configuration"
  config D0
    int "D0"
    default "5"
  config D1
    int "D1"
    default "18"
  config D2
    int "D2"
    default "19"
  config D3
    int "D3"
    default "21"
  config D4
    int "D4"
    default "36"
  config D5
    int "D5"
    default "39"
  config D6
    int "D6"
    default "34"
  config D7
    int "D7"
    default "35"
  config XCLK
    int "XCLK"
    default "0"
  config PCLK
    int "PCLK"
    default "22"
  config VSYNC
    int "VSYNC"
    default "25"
  config HREF
    int "HREF"
    default "23"
  config SDA
    int "SDA"
    default "26"
  config SCL
    int "SCL"
    default "27"
  config RESET
    int "RESET"
    default "-1"
  config PWDN
    int "PWDN"
    default "32"
endmenu

config OV2640_SUPPORT
  bool "OV2640 Support"
  default y
  help
    Enable this option if you want to use the OV2640.
    Disable this option to save memory.

config OV7725_SUPPORT
  bool "OV7725 Support"
  default n
  help
    Enable this option if you want to use the OV7725.
    Disable this option to save memory.
  
config OV3660_SUPPORT
  bool "OV3660 Support"
  default n
  help
    Enable this option if you want to use the OV3360.
    Disable this option to save memory.
    
config OV5640_SUPPORT
  bool "OV5640 Support"
  default n
  help
    Enable this option if you want to use the OV5640.
    Disable this option to save memory.

choice CAMERA_TASK_PINNED_TO_CORE
  bool "Camera task pinned to core"
  default CAMERA_CORE0
  help
    Pin the camera handle task to a certain core(0/1). It can also be done automatically choosing NO_AFFINITY.

  config CAMERA_CORE0
    bool "CORE0"
  config CAMERA_CORE1
    bool "CORE1"
  config CAMERA_NO_AFFINITY
    bool "NO_AFFINITY"

endchoice
	
choice SCCB_HARDWARE_I2C_PORT
    bool "I2C peripheral to use for SCCB"
    default SCCB_HARDWARE_I2C_PORT1

    config SCCB_HARDWARE_I2C_PORT0
        bool "I2C0"
    config SCCB_HARDWARE_I2C_PORT1
        bool "I2C1"

endchoice

  config SCCB_CLK_FREQ
  int "SCCB clk frequency"
  default 100000
  range 100000 400000
  help
    Increasing this value can reduce the initialization time of the sensor.
    Please refer to the relevant instructions of the sensor to adjust the value.4

config CAMERA_TASK_STACK_SIZE
        int "CAM task stack size"
        default 2048
        help
            Camera task stack size

    choice CAMERA_TASK_PINNED_TO_CORE
        bool "Camera task pinned to core"
        default CAMERA_CORE0
        help
            Pin the camera handle task to a certain core(0/1). It can also be done automatically choosing NO_AFFINITY.

        config CAMERA_CORE0
            bool "CORE0"
        config CAMERA_CORE1
            bool "CORE1"
        config CAMERA_NO_AFFINITY
            bool "NO_AFFINITY"

    endchoice

    config CAMERA_DMA_BUFFER_SIZE_MAX
        int "DMA buffer size"
        range 8192 32768
        default 32768
        help
            Maximum value of DMA buffer
            Larger values may fail to allocate due to insufficient contiguous memory blocks, and smaller value may cause DMA interrupt to be too frequent.

    config CAMERA_CONVERTER_ENABLED
        bool "Enable camera RGB/YUV converter"
        depends on IDF_TARGET_ESP32S3
        default n
        help
            Enable this option if you want to use RGB565/YUV422/YUV420/YUV411 format conversion.

    choice CAMERA_CONV_PROTOCOL
        bool "Camera converter protocol"
        depends on CAMERA_CONVERTER_ENABLED
        default LCD_CAM_CONV_BT601_ENABLED
        help
            Supports format conversion under both BT601 and BT709 standards.

        config LCD_CAM_CONV_BT601_ENABLED
            bool "BT601"
        config LCD_CAM_CONV_BT709_ENABLED
            bool "BT709"
    endchoice

    config LCD_CAM_CONV_FULL_RANGE_ENABLED
        bool "Camera converter full range mode"
        depends on CAMERA_CONVERTER_ENABLED
        default y
        help
            Supports format conversion under both full color range mode and limited color range mode.
            If full color range mode is selected, the color range of RGB or YUV is 0~255.
            If limited color range mode is selected, the color range of RGB is 16~240, and the color range of YUV is Y[16~240], UV[16~235].
            Full color range mode has a wider color range, so details in the image show more clearly.
            Please confirm the color range mode of the current camera sensor, incorrect color range mode may cause color difference in the final converted image.
            Full range mode is used by default. If this option is not selected, the format conversion function will be done using the limited range mode.

    config LCD_CAM_ISR_IRAM_SAFE
        bool "Execute camera ISR from IRAM"
        depends on (IDF_TARGET_ESP32S2 || IDF_TARGET_ESP32S3)
        default n
        help
            If this option is enabled, camera ISR will execute from IRAM.
endmenu
```
